## arch/arc/plat-arcfpga/Kconfig
```kconfig
#
# Copyright (C) 2007-2010, 2011-2012 Synopsys, Inc. (www.synopsys.com)
#
# This program is free software; you can redistribute it and/or modify
# it under the terms of the GNU General Public License version 2 as
# published by the Free Software Foundation.
#

if ARC_PLAT_FPGA_LEGACY

choice
	prompt "FPGA Board"

config ARC_BOARD_ANGEL4
	bool "ARC Angel4"
	help
	  ARC Angel4 FPGA Ref Platform (Xilinx Virtex Based)

config ARC_BOARD_ML509
	bool "ML509"
	help
	  ARC ML509 FPGA Ref Platform (Xilinx Virtex-5 Based)

endchoice

config ISS_SMP_EXTN
	bool "ARC SMP Extensions (ISS Models only)"
	default n
	select ARC_HAS_IPI
	help
	  SMP Extensions to ARC700, in a "simulation only" Model, supported in
	  ARC ISS (Instruction Set Simulator).
	  The SMP extensions include:
	  -IDU (Interrupt Distribution Unit)
	  -XTL (To enable CPU start/stop/set-PC for another CPU)
	  It doesn't provide coherent Caches and/or Atomic Ops (LLOCK/SCOND)

config ARC_SERIAL_BAUD
	int "UART Baud rate"
	default "115200"
	depends on SERIAL_ARC
	help
	  Baud rate for the ARC UART

# Platform specific IRQ wiring - tied to devices - feeds into ARC arch code
config ARC_TIMER_LV2
	bool "High Priority Timer0 IRQ"
	depends on ARC_COMPACT_IRQ_LEVELS
	select ARC_IRQ3_LV2

# Timer HAS to be high priority, for any other high priority config
config ARC_SERIAL_LV2
	bool "High Priority Serial IRQ"
	depends on ARC_SERIAL && ARC_TIMER_LV2
	depends on ARC_COMPACT_IRQ_LEVELS
	select ARC_IRQ5_LV2

menuconfig ARC_HAS_BVCI_LAT_UNIT
	bool "BVCI Bus Latency Unit"
	depends on ARC_BOARD_ML509 || ARC_BOARD_ANGEL4
	help
	  IP to add artifical latency to BVCI Bus Based FPGA builds.
	  The default latency (even worst case) for FPGA is non-realistic
	  (~10 SDRAM, ~5 SSRAM).

config BVCI_LAT_UNITS
	hex "Latency Unit(s) Bitmap"
	default "0x0"
	depends on ARC_HAS_BVCI_LAT_UNIT
	help
	  There are multiple Latency Units corresponding to the many
	  interfaces of the system bus arbiter (both CPU side as well as
	  the peripheral side).
	  To add latency to ALL memory transaction, choose Unit 0, otherwise
	  for finer grainer - interface wise latency, specify a bitmap (1 bit
	  per unit) of all units. e.g. 1,2,12 will be 0x1003

	  Unit  0 - System Arb and Mem Controller
	  Unit  1 - I$ and System Bus
	  Unit  2 - D$ and System Bus
	  ..
	  Unit 12 - IDE Disk controller and System Bus

config BVCI_LAT_CYCLES
	int "Latency Value in cycles"
	range 0 63
	default "30"
	depends on ARC_HAS_BVCI_LAT_UNIT

endif
```
